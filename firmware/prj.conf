## CMakeLists.txt
```
# SPDX-License-Identifier: Apache-2.0

cmake_minimum_required(VERSION 3.20.0)

find_package(Zephyr REQUIRED HINTS $ENV{ZEPHYR_BASE})
project(clicker)

FILE(GLOB app_sources src/*.c)
target_sources(app PRIVATE
  ${app_sources}
  )
```

## prj.conf
```kconfig
CONFIG_LOG=y
CONFIG_CONSOLE=y
CONFIG_RTT_CONSOLE=y
CONFIG_USE_SEGGER_RTT=y
CONFIG_CBPRINTF_FP_SUPPORT=y
CONFIG_LOG_BUFFER_SIZE=10240
CONFIG_SEGGER_RTT_BUFFER_SIZE_UP=10240

CONFIG_LED=y
CONFIG_GPIO=y
CONFIG_PWM=y
CONFIG_LED_PWM=y

CONFIG_BT=y
CONFIG_BT_SMP=y
CONFIG_BT_PERIPHERAL=y
CONFIG_BT_DEVICE_NAME="Clicker"
CONFIG_BT_ATT_ENFORCE_FLOW=n

CONFIG_FLASH=y
CONFIG_FLASH_MAP=y
CONFIG_BOOTLOADER_MCUBOOT=y
CONFIG_ZCBOR=y
CONFIG_MCUMGR=y
CONFIG_MCUMGR_TRANSPORT_BT=y
CONFIG_MCUMGR_TRANSPORT_BT_AUTHEN=n
CONFIG_MCUMGR_TRANSPORT_BT_CONN_PARAM_CONTROL=y
CONFIG_MCUMGR_TRANSPORT_BT_REASSEMBLY=y
CONFIG_MCUMGR_TRANSPORT_NETBUF_SIZE=2475
CONFIG_MCUMGR_GRP_OS_MCUMGR_PARAMS=y
CONFIG_MCUMGR_TRANSPORT_WORKQUEUE_STACK_SIZE=4608
CONFIG_MCUMGR_GRP_ZBASIC=y
CONFIG_MCUMGR_GRP_ZBASIC_STORAGE_ERASE=y
CONFIG_STREAM_FLASH=y
CONFIG_IMG_MANAGER=y
CONFIG_MCUMGR_GRP_IMG=y
CONFIG_MCUMGR_GRP_OS=y
CONFIG_BT_CTLR_LE_PING=n
CONFIG_SYSTEM_WORKQUEUE_STACK_SIZE=2304
```

## src/main.c
```c
/* main.c - Application main entry point */

/*
 * Copyright (c) 2019 Aaron Tsui <aaron.tsui@outlook.com>
 *
 * SPDX-License-Identifier: Apache-2.0
 */

#include <errno.h>
#include <stddef.h>
#include <string.h>
#include <zephyr/bluetooth/bluetooth.h>
#include <zephyr/bluetooth/conn.h>
#include <zephyr/bluetooth/gatt.h>
#include <zephyr/bluetooth/hci.h>
#include <zephyr/bluetooth/services/bas.h>
#include <zephyr/bluetooth/uuid.h>
#include <zephyr/kernel.h>
#include <zephyr/logging/log.h>
#include <zephyr/sys/byteorder.h>
#include <zephyr/sys/printk.h>
#include <zephyr/types.h>

#include "bt.h"
#include "gpio.h"
#include "temp.h"

LOG_MODULE_REGISTER(main, LOG_LEVEL_INF);

#define MIN_ADV_INTERVAL 999
#define MAX_ADV_INTERVAL 1001
#define ADV_INTERVAL_MULTIPLIER 0.625

static const struct bt_data ad[] = {
	BT_DATA_BYTES(BT_DATA_FLAGS, (BT_LE_AD_GENERAL | BT_LE_AD_NO_BREDR)),
};

static struct bt_le_adv_param adv_param =
		BT_LE_ADV_PARAM_INIT(BT_LE_ADV_OPT_CONNECTABLE | BT_LE_ADV_OPT_USE_NAME,
							 MIN_ADV_INTERVAL / ADV_INTERVAL_MULTIPLIER,
							 MAX_ADV_INTERVAL / ADV_INTERVAL_MULTIPLIER, NULL);

static void connected(struct bt_conn *conn, uint8_t err)
{
	if (err) {
		LOG_INF("Connection failed (err 0x%02x)", err);
	} else {
		LOG_INF("Connected");
	}
}

static void disconnected(struct bt_conn *conn, uint8_t reason)
{
	LOG_INF("Disconnected (reason 0x%02x)", reason);
}

BT_CONN_CB_DEFINE(conn_callbacks) = {
	.connected = connected,
	.disconnected = disconnected,
};

static void bt_ready(void)
{
	int err;

	LOG_INF("Bluetooth initialized");

	err = bt_le_adv_start(&adv_param, ad, ARRAY_SIZE(ad), NULL, 0);
	if (err) {
		LOG_INF("Advertising failed to start (err %d)", err);
		return;
	}

	LOG_INF("Advertising successfully started");
}

static void auth_cancel(struct bt_conn *conn)
{
	char addr[BT_ADDR_LE_STR_LEN];

	bt_addr_le_to_str(bt_conn_get_dst(conn), addr, sizeof(addr));

	LOG_INF("Pairing cancelled: %s", addr);
}

static struct bt_conn_auth_cb auth_cb_display = {
	.cancel = auth_cancel,
};

int main(void)
{
	int err;

	gpio_init();
	temp_init();
	bt_init(temp_get);

	err = bt_enable(NULL);
	if (err) {
		LOG_INF("Bluetooth init failed (err %d)", err);
		return 0;
	}

	bt_ready();

	bt_conn_auth_cb_register(&auth_cb_display);

	return 0;
}
```

## src/bt.c
```c
#include <zephyr/bluetooth/gatt.h>
#include <zephyr/bluetooth/uuid.h>
#include <zephyr/kernel.h>
#include <zephyr/logging/log.h>

#include "bt.h"

LOG_MODULE_REGISTER(bt, LOG_LEVEL_INF);

/** @brief UUID of the Button Service. */
#define BT_UUID_BUTTON_SERVICE_RAW                                                                 \
	BT_UUID_128_ENCODE(0xa4de0201, 0xa156, 0x493c, 0x83d8, 0x845c40da5203)

/** @brief UUID of the Button TX Characteristic. */
#define BT_UUID_BUTTON_TX_RAW BT_UUID_128_ENCODE(0xa4de0202, 0xa156, 0x493c, 0x83d8, 0x845c40da5203)

#define BT_UUID_BUTTON_SERVICE BT_UUID_DECLARE_128(BT_UUID_BUTTON_SERVICE_RAW)
#define BT_UUID_BUTTON_TX_CHAR BT_UUID_DECLARE_128(BT_UUID_BUTTON_TX_RAW)

enum bt_send_status {
	BT_SEND_ENABLED,
	BT_SEND_DISABLED,
};

static void on_tx_char_ccc_cfg_changed(const struct bt_gatt_attr *attr, uint16_t value);
static void notify_cb(struct k_work *work);

static float latest_temp_reading;
static double (*on_subscribe_cb)(void) = NULL;

K_WORK_DEFINE(notify_work, notify_cb);
K_MUTEX_DEFINE(temp_mutex);

BT_GATT_SERVICE_DEFINE(auth_svc, BT_GATT_PRIMARY_SERVICE(BT_UUID_BUTTON_SERVICE),
					   BT_GATT_CHARACTERISTIC(BT_UUID_BUTTON_TX_CHAR, // uuid
											  BT_GATT_CHRC_NOTIFY, // props
											  BT_GATT_PERM_READ, // permissions
											  NULL, // read attribute cb
											  NULL, // write attribute cb
											  NULL), // user data
					   BT_GATT_CCC(on_tx_char_ccc_cfg_changed,
								   BT_GATT_PERM_READ | BT_GATT_PERM_WRITE));

static void on_tx_char_sent(struct bt_conn *conn, void *user_data)
{
	ARG_UNUSED(user_data);

	char addr[BT_ADDR_LE_STR_LEN];
	bt_addr_le_to_str(bt_conn_get_dst(conn), addr, ARRAY_SIZE(addr));
	LOG_INF("Data sent over TX characteristic to %s", addr);
}

static int tx_char_send(struct bt_conn *conn, const uint8_t *data, uint16_t len)
{
	LOG_DBG("Sending data over TX characteristic");
	struct bt_gatt_notify_params params = { 0 };
	/* TODO (DTP): limit the search by restricting range */
	const struct bt_gatt_attr *attr = bt_gatt_find_by_uuid(NULL, 0, BT_UUID_BUTTON_TX_CHAR);

	params.attr = attr;
	params.data = data;
	params.len = len;
	params.func = on_tx_char_sent;

	if (!conn) {
		LOG_DBG("Notification send to all connected peers");
		return bt_gatt_notify_cb(NULL, &params);
	} else if (bt_gatt_is_subscribed(conn, attr, BT_GATT_CCC_NOTIFY)) {
		return bt_gatt_notify_cb(conn, &params);
	} else {
		return -EINVAL;
	}
}

static void on_tx_char_ccc_cfg_changed(const struct bt_gatt_attr *attr, uint16_t value)
{
	enum bt_send_status status = (value == BT_GATT_CCC_NOTIFY) ? BT_SEND_ENABLED : BT_SEND_DISABLED;

	switch (status) {
	case BT_SEND_ENABLED:
		LOG_INF("Notifications enabled");
		bt_notify(on_subscribe_cb());
		break;
	case BT_SEND_DISABLED:
		LOG_INF("Notifications disabled");
		break;
	default:
		LOG_ERR("Unknown value");
		return;
	}
}

static void notify_cb(struct k_work *work)
{
	uint8_t data[sizeof(float)];

	k_mutex_lock(&temp_mutex, K_FOREVER);
	memcpy(data, &latest_temp_reading, sizeof(latest_temp_reading));
	k_mutex_unlock(&temp_mutex);

	(void)tx_char_send(NULL, data, sizeof(data));
}

void bt_init(double (*on_subscribe)(void))
{
	on_subscribe_cb = on_subscribe;
}

void bt_notify(double temp)
{
	k_mutex_lock(&temp_mutex, K_FOREVER);
	latest_temp_reading = temp;
	k_mutex_unlock(&temp_mutex);

	int err = k_work_submit(&notify_work);
	if (err < 0) {
		LOG_ERR("Failed to submit work to generate the challenge, error %d", err);
	}
}
```

## src/bt.h
```c
#ifndef BT_H_
#define BT_H_

void bt_init(double (*on_subscribe)(void));

void bt_notify(double temp);

#endif
```

## src/gpio.c
```c
#include <zephyr/drivers/gpio.h>
#include <zephyr/drivers/led.h>
#include <zephyr/drivers/pwm.h>
#include <zephyr/kernel.h>
#include <zephyr/logging/log.h>

#include "bt.h"
#include "gpio.h"
#include "temp.h"

LOG_MODULE_REGISTER(gpio, LOG_LEVEL_INF);

#define BUTTON_NODE DT_NODELABEL(button)
#define POWER_KILL_PIN DT_NODELABEL(power_kill_pin)

#define GREEN_LED_PWM_PCT 100U
#define AMBER_LED_PWM_PCT 30U

enum led_colour {
	LED_OFF,
	LED_GREEN,
	LED_AMBER,
};

static void button_pressed(const struct device *dev, struct gpio_callback *cb, uint32_t pins);
static void button_released(const struct device *dev, struct gpio_callback *cb, uint32_t pins);
static void led_timer_timeout_cb(struct k_timer *timer);
static void long_button_press_timeout_cb(struct k_timer *timer);
static void long_button_press_cb(struct k_work *work);

K_TIMER_DEFINE(led_timer, led_timer_timeout_cb, NULL);
K_TIMER_DEFINE(long_button_press_timer, long_button_press_timeout_cb, NULL);
K_WORK_DEFINE(long_button_press_work, long_button_press_cb);

static const struct gpio_dt_spec button_node = GPIO_DT_SPEC_GET(BUTTON_NODE, gpios);
static const struct pwm_dt_spec green_pwm_led = PWM_DT_SPEC_GET(DT_NODELABEL(green_led_pwm));
static const struct pwm_dt_spec amber_pwm_led = PWM_DT_SPEC_GET(DT_NODELABEL(yellow_led_pwm));
static const struct device *pwm_leds_dev = DEVICE_DT_GET(DT_PARENT(DT_NODELABEL(green_led_pwm)));
static struct gpio_callback button_cb_data;
static const struct gpio_dt_spec pwr_kill_pin = GPIO_DT_SPEC_GET(POWER_KILL_PIN, gpios);

/**************************************************************************************************
 * FUNCTIONS
 **************************************************************************************************/

static uint8_t get_green_led_pwm(void)
{
	return GREEN_LED_PWM_PCT;
}

static uint8_t get_amber_led_pwm(void)
{
	return AMBER_LED_PWM_PCT;
}

static void configure_leds(void)
{
	if (!device_is_ready(pwm_leds_dev)) {
		LOG_ERR("Device %s is not ready", pwm_leds_dev->name);
		return;
	}
	if (!device_is_ready(amber_pwm_led.dev)) {
		LOG_ERR("Device %s is not ready", amber_pwm_led.dev->name);
		return;
	}
	if (!device_is_ready(green_pwm_led.dev)) {
		LOG_ERR("Device %s is not ready", green_pwm_led.dev->name);
		return;
	}
}

static void configure_button_interrupt(void(*button_callback), bool rising_edge)
{
	int ret;
	if (rising_edge) {
		ret = gpio_pin_interrupt_configure_dt(&button_node, GPIO_INT_EDGE_RISING);
	} else {
		ret = gpio_pin_interrupt_configure_dt(&button_node, GPIO_INT_EDGE_FALLING);
	}
	if (ret != 0) {
		LOG_ERR("Error %d: failed to configure interrupt on %s pin %d", ret, button_node.port->name,
				button_node.pin);
		return;
	}
	gpio_init_callback(&button_cb_data, button_callback, BIT(button_node.pin));
	gpio_add_callback(button_node.port, &button_cb_data);
}

static void configure_button(const struct gpio_dt_spec *button)
{
	int ret;
	ret = gpio_pin_configure_dt(button, GPIO_INPUT);
	if (ret != 0) {
		LOG_ERR("Error %d: failed to configure %s pin %d", ret, button->port->name, button->pin);
		return;
	}
	if (!device_is_ready(button->port)) {
		LOG_ERR("Error: button device %s is not ready", button->port->name);
		return;
	}
	/* Wearable button pin is ACTIVE_HIGH */
	configure_button_interrupt(button_pressed, true);
}

void gpio_init(void)
{
	configure_button(&button_node);
	configure_leds();
}

int gpio_green_led_on(void)
{
	int err = led_set_brightness(pwm_leds_dev, green_pwm_led.channel, get_green_led_pwm());
	if (err != 0) {
		LOG_ERR("Failed to set green PWM LED brightness to %d PWM.", get_green_led_pwm());
	} else {
		LOG_DBG("Green PWM LED on");
	}
	return err;
}

int gpio_green_led_off(void)
{
	int err = led_off(pwm_leds_dev, green_pwm_led.channel);
	if (err != 0) {
		LOG_ERR("Failed to turn off PWM LED");
	} else {
		LOG_DBG("Green PWM LED off");
	}
	return err;
}

int gpio_amber_led_on(void)
{
	int err = led_set_brightness(pwm_leds_dev, amber_pwm_led.channel, get_amber_led_pwm());
	if (err != 0) {
		LOG_ERR("Failed to set amber PWM LED brightness to %d PWM.", get_amber_led_pwm());
	} else {
		LOG_DBG("Amber PWM LED on");
	}
	return err;
}

int gpio_amber_led_off(void)
{
	int err = led_off(pwm_leds_dev, amber_pwm_led.channel);
	if (err != 0) {
		LOG_ERR("Failed to turn off amber PWM LED");
	} else {
		LOG_DBG("Amber PWM LED off");
	}
	return err;
}

static void button_pressed(const struct device *dev, struct gpio_callback *cb, uint32_t pins)
{
	LOG_INF("Button pressed");

	float temp = (float)temp_get();

	if (temp >= TEMP_MILD) {
		gpio_green_led_on();
	} else {
		gpio_amber_led_on();
	}

	k_timer_start(&long_button_press_timer, K_SECONDS(18), K_NO_WAIT);
	k_timer_start(&led_timer, K_SECONDS(1), K_NO_WAIT);

	bt_notify(temp);

	configure_button_interrupt(button_released, false);
}

static void button_released(const struct device *dev, struct gpio_callback *cb, uint32_t pins)
{
	k_timer_stop(&long_button_press_timer);

	configure_button_interrupt(button_pressed, true);
}

static void led_timer_timeout_cb(struct k_timer *timer)
{
	(void)gpio_green_led_off();
	(void)gpio_amber_led_off();
}

static void poweroff(void)
{
	LOG_INF("Powering system off");

	int err = gpio_pin_configure_dt(&pwr_kill_pin, GPIO_OUTPUT_ACTIVE);
	if (err != 0) {
		LOG_ERR("Failed to set power kill signal, aborting power off. Error %d", err);
	}
}

static void long_button_press_timeout_cb(struct k_timer *timer)
{
	int err = k_work_submit(&long_button_press_work);
	if (err < 0) {
		LOG_ERR("Failed to submit work of executing long button press event, error %d", err);
	}
}

static void long_button_press_cb(struct k_work *work)
{
	poweroff();
}
```

## src/gpio.h
```c
#ifndef GPIO_H_
#define GPIO_H_

#include <zephyr/drivers/sensor.h>

void gpio_init(void);

int gpio_green_led_on(void);

int gpio_green_led_off(void);

int gpio_amber_led_on(void);

int gpio_amber_led_off(void);

#endif /* GPIO_H_ */
```

## src/temp.c
```c
#include "temp.h"

#include <zephyr/drivers/sensor.h>
#include <zephyr/logging/log.h>

LOG_MODULE_REGISTER(temp, LOG_LEVEL_INF);

static const struct device *temp_dev = DEVICE_DT_GET_ANY(nordic_nrf_temp);

void temp_init(void)
{
	if (temp_dev == NULL || !device_is_ready(temp_dev)) {
		LOG_WRN("no temperature device");
	} else {
		LOG_INF("temp device is %p, name is %s", temp_dev, temp_dev->name);
	}
}

double temp_get(void)
{
	struct sensor_value temp_value;

	int err = sensor_sample_fetch(temp_dev);
	if (err) {
		LOG_INF("sensor_sample_fetch failed return: %d", err);
	}

	err = sensor_channel_get(temp_dev, SENSOR_CHAN_DIE_TEMP, &temp_value);
	if (err) {
		LOG_INF("sensor_channel_get failed return: %d", err);
	}

	double temp = sensor_value_to_double(&temp_value);
	LOG_INF("temperature is %gC", temp);

	return temp;
}
```

## src/temp.h
```c
#ifndef TEMP_H_
#define TEMP_H_

#define TEMP_MILD 20U

void temp_init(void);

double temp_get(void);

#endif
```
